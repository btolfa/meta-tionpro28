## conf/layer.conf
```bitbake
# We have a conf and classes directory, add to BBPATH
BBPATH .= ":${LAYERDIR}"

# We have a recipes-* directories, add to BBFILES
BBFILES += "${LAYERDIR}/recipes-*/*/*.bb \
	${LAYERDIR}/recipes-*/*/*.bbappend"

BBFILE_COLLECTIONS += "tionpro28"
BBFILE_PATTERN_tionpro28 = "^${LAYERDIR}/"
BBFILE_PRIORITY_tionpro28 = "6"
```

## conf/machine/tionpro28.conf
```bitbake
#@TYPE: Machine
#@NAME: Tion-Pro28 
#@SOC: i.MX28
#@DESCRIPTION: Machine configuration for Tion-Pro28
#@MAINTAINER: Tengiz Sharafiev <btolfa@gmail.com>

include conf/machine/include/my_mxs-base.inc

SOC_FAMILY = "mxs:mx28:tionpro28"

UBOOT_CONFIG ??= "sd"
UBOOT_CONFIG[sd] = "mx28evk_config,sdcard"
UBOOT_CONFIG[sd-auart-console] = "mx28evk_auart_console_config,sdcard"

KERNEL_IMAGETYPE = "zImage"
KERNEL_DEVICETREE = "imx28-tion-pro28.dtb"

IMAGE_FSTYPES ?= "tar.bz2 ext3 uboot.mxsboot-sdcard sdcard"
SDCARD_ROOTFS ?= "${DEPLOY_DIR_IMAGE}/${IMAGE_NAME}.rootfs.ext3"

SERIAL_CONSOLE = "115200 ttyAMA0"

MACHINE_FEATURES = "usbgadget usbhost vfat alsa"
```

## conf/machine/tionpro28k41.conf
```bitbake
#@TYPE: Machine
#@NAME: Tion-Pro28 
#@SOC: i.MX28
#@DESCRIPTION: Machine configuration for Tion-Pro28
#@MAINTAINER: Tengiz Sharafiev <btolfa@gmail.com>

include conf/machine/include/imx-base.inc
include conf/machine/include/tune-arm926ejs.inc

SOC_FAMILY = "mxs:mx28"

IMXBOOTLETS_MACHINE = "iMX28_EVK"

UBOOT_CONFIG ??= "sd"
UBOOT_CONFIG[sd] = "mx28evk_config,sdcard"
UBOOT_CONFIG[nand] = "mx28evk_nand_config,ubifs"
UBOOT_CONFIG[sd-auart-console] = "mx28evk_auart_console_config,sdcard"

KERNEL_DEVICETREE = "imx28-tion.dtb"

SERIAL_CONSOLE = "115200 ttyAMA0"

MACHINE_FEATURES = "apm usbgadget usbhost vfat alsa"
```
